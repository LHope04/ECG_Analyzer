#include "FIRFilter.h"
#include "main.h"
#include "queue.h"
#include "usart.h"
#include "stdio.h"

#define hLength 161
//FIR滤波器参数
const double coefficient = 4.0;
struct queue FIRQueue;
int16_t FIRResult;
int FIRA[hLength];
const double B[161] = {
        -0.0004252435314418,-0.0005884437552072,4.592260926887e-05,-5.480892870666e-05,
  0.0003747042586993,0.0003849094357773,0.0003918838730681,7.987982458523e-05,
  -0.0002634063831323,-0.0005819541887895,-0.0006366709744874,-0.0003939413936649,
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  0.0003747042586993,-5.480892870666e-05,4.592260926887e-05,-0.0005884437552072,
  -0.0004252435314418
};
double h[161];

//初始化FIR滤波器参数 完成FIR队列创建工作
void FIRInit(){
    queueInit(& FIRQueue,FIRA,hLength);
    for(int i = 1;i <= hLength;i++){
        queuePush(& FIRQueue,0);
    }
    HAL_Delay(2000);
    for(int j = 0;j < hLength;j++){
        h[j] = B[j] * 65536;
    }
}


int16_t last_data = 0xffff;


void FIRFilter(int16_t in){
    //过滤掉重复的
    if (in == last_data)
        return;
    else
        last_data = in;



    queuePop(&FIRQueue);  //先弹出一个
    queuePush(&FIRQueue,in);  //向其中加入新来的元素
    //queuePrint(&FIRQueue);
    //printf("--------------\n");

    double sum = 0;
    int count = hLength - 1;  //指向h末尾的位置

    //随后遍历整个队列 计算出滤波之后的结果
    int pointer = FIRQueue.front;
    if (FIRQueue.count == 0) {
        return;
    }
    else if (FIRQueue.front <= FIRQueue.rear) {
        while (pointer <= FIRQueue.rear) {
            sum += (FIRQueue.array[pointer] * B[count]);
            count -- ;
            pointer++;
        }
    }
    else {
        for (; pointer <= FIRQueue.maxSize - 1; pointer++) {
            sum += (FIRQueue.array[pointer] * B[count]);
            count -- ;
        }
        for (pointer = 0; pointer <= FIRQueue.rear; pointer++) {
            sum += (FIRQueue.array[pointer] * B[count]);
            count -- ;
        }
    }
    FIRResult = sum * coefficient;

    //printf("%d\r\n", FIRResult);
}

/*
 * @brief 检测心跳
 * @param value 采样数值
 * @return 0 不是心跳 1 是心跳
 */
extern int16_t maxfft;
int heartbeat_check(int value)
{
     int heartbeat_thresh = maxfft/4*2; //心跳下降沿阈值，下降沿高度大于该阈值视为一次心跳
    static int is_init = 0;
    static int up_value = 0;// 波峰数值
    static int down_value = 0;// 波谷数值

    if (!is_init) {
        is_init = 1;
        up_value = value; down_value = value; //首先将当前值视为波峰，波谷
        return 0;
    }
    if (value <= down_value) { //波形正在下降
        down_value = value;
    } else { //波形正在上升，说明检测到波谷
        if ((up_value - down_value) >= heartbeat_thresh) { //检测到心跳
            up_value = value; down_value = value; //将当前值重新时为波峰，波谷，准备下一次检测心跳
            return 1;
        } else {
            up_value = value; down_value = value; //将当前值重新时为波峰，波谷，准备下一次检测心跳
        }
    }
    return 0;
}

/*
 * @brief 计算心跳率
 * @param is_heartbeat 是否是心跳 0 或者 1
 * @return 心跳 个/每分钟
 */
double calc_heartbeat_rate(int is_heartbeat)
{
    static double sampling_rate = 500; //250Hz
    static double heartbeat_rate = 0;
    static double heartbeat_timestamp = 0;

    if (!is_heartbeat) {
        ++heartbeat_timestamp;
        return heartbeat_rate; //直接返回心跳
    }
    heartbeat_rate = 1.0 / heartbeat_timestamp * sampling_rate * 60;
    heartbeat_timestamp = 0;
    return heartbeat_rate;
}
